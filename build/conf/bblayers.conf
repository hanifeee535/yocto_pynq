## build/conf/bblayers.conf
```bitbake
# POKY_BBLAYERS_CONF_VERSION is increased each time build/conf/bblayers.conf
# changes incompatibly
POKY_BBLAYERS_CONF_VERSION = "2"

BBPATH = "${TOPDIR}"
BBFILES ?= ""

BBLAYERS ?= " \
  /home/student/Desktop/yocto_pynq/yocto_pynq/poky/meta \
  /home/student/Desktop/yocto_pynq/yocto_pynq/poky/meta-poky \
  /home/student/Desktop/yocto_pynq/yocto_pynq/poky/meta-yocto-bsp \
  /home/student/Desktop/yocto_pynq/yocto_pynq/meta-xilinx/meta-xilinx-bsp \
  /home/student/Desktop/yocto_pynq/yocto_pynq/meta-xilinx/meta-xilinx-contrib \
  /home/student/Desktop/yocto_pynq/yocto_pynq/meta-pynq \
  "
```
